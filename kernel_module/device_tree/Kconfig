## kernel_module/device_tree/Kconfig
```kconfig
config MY_PLATFORM_DRIVER
        bool "My platform driver"
	depends on ARM
        help
          Select this configuration to enable the platform driver example.
```

## kernel_module/platform_driver/Kconfig
```kconfig
config MY_PLATFORM_DRIVER
        tristate "My platform driver"
	depends on ARM
        help
          Select this configuration to enable the platform driver example.
```
